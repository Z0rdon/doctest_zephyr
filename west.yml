## west.yml
```yaml
# SPDX-License-Identifier: MIT
# Copyright (c) 2023 

manifest:
  remotes:
    - name: doctest_remote
      url-base: https://github.com/doctest

  projects:
    - name: doctest
      revision: v2.4.11
      remote: doctest_remote
      path: modules/lib/doctest
```

## zephyr/Kconfig
```kconfig
# Copyright 2023
#
# SPDX-License-Identifier: MIT

config DOCTEST
	bool "Doctest unit testing framework"
	default n
  select CPLUSPLUS
  select LIB_CPLUSPLUS
	help
	  Enable the doctest unit testing framework (requires cpp).

config DOCTEST_MAIN_VOID_RETURN
	bool "Use a void return from main for doctest"
	default n
  depends on DOCTEST
	help
	  Older versions of zephyr required a void return from main.

config DOCTEST_USE_EXCEPTIONS
  bool "Enable C++ doctest exception functionality"
  default n
  depends on (DOCTEST && EXCEPTIONS)
  help
    Enable C++ exceptions and allow doctest exception functionality
```
